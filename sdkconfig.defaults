## sdkconfig.defaults
```kconfig
# Rust often needs a bit of an extra main task stack size compared to C (the default is 3K)
CONFIG_ESP_MAIN_TASK_STACK_SIZE=10000

# Use this to set FreeRTOS kernel tick frequency to 1000 Hz (100 Hz by default).
# This allows to use 1 ms granuality for thread sleeps (10 ms by default).
#CONFIG_FREERTOS_HZ=1000

# Workaround for https://github.com/espressif/esp-idf/issues/7631
#CONFIG_MBEDTLS_CERTIFICATE_BUNDLE=n
#CONFIG_MBEDTLS_CERTIFICATE_BUNDLE_DEFAULT_FULL=n

# Enable external PSRAM without high-mem support
# Unfortunately RAM space exceeding 4MB cannot be directly integrated in ESP32 chips
CONFIG_SPIRAM=y
#CONFIG_SPIRAM_TYPE_AUTO=y
#CONFIG_SPIRAM_SPEED_40M=y
CONFIG_SPIRAM_BOOT_INIT=y
CONFIG_SPIRAM_IGNORE_NOTFOUND=y
CONFIG_SPIRAM_USE_MALLOC=y
CONFIG_SPIRAM_MEMTEST=y
# The values are arbitrary
CONFIG_SPIRAM_MALLOC_ALWAYSINTERNAL=16384
CONFIG_SPIRAM_MALLOC_RESERVE_INTERNAL=32768
# further tweaks, the workaround is not required on m5core2v11 which has V3 chip
CONFIG_SPIRAM_CACHE_WORKAROUND=n
# don't use it for the moment, will cause severe psram fragmentation
# read: https://github.com/espressif/esp-idf/issues/11753
#CONFIG_SPIRAM_TRY_ALLOCATE_WIFI_LWIP=y

# Enable and use BT with nimble stack.
CONFIG_BT_ENABLED=y
CONFIG_BT_BLE_ENABLED=y
CONFIG_BT_BLUEDROID_ENABLED=n
CONFIG_BT_NIMBLE_ENABLED=y
```
